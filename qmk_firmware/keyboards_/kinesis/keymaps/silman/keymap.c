#include QMK_KEYBOARD_H

extern keymap_config_t keymap_config;

#define BLUE_LED 0
#define GREEN_LED 1
#define ORANGE_LED 2
#define RED_LED 3

enum kinesis_layers {
  _BASE,         // QWERTY Base Layer
  _MACOS,        // MacOS thumb clusters
  _ADVANCED,     // Advanced thumb clusters with quick layer access
  _FUNCTION,     // Function
  _NUMBERS,      // Numbers & Symbols
  _NUMBERS2,     // Identical to _NUMBERS; used for tri-layer access to Antechamber
  _NUMPAD,       // Numpad layer
  _GAME,         // Gaming layer for WASD games
  _ADJUST,  // Utility layer, accessed via One-shot
  _ADJUST2, // Utility layer, accessed via Tri-State
};

enum kinesis_keycodes {
  BASE = SAFE_RANGE,
  MACOS,
  GAME,
  MOCKMODE,
};

enum custom_keycodes {
    CU_BKDL = SAFE_RANGE,
    CU_MOCK
};

// State variables
static bool mock_mode_enable = false;
static bool mock_mode_shift_enable = false;

//Tap Dance Declarations
enum {
  ADJ = 0,
  LBCB,
  RBCB,
  LPAB,
  RPAB,
  EQPL,
  PLEQ,
  MNUN,
  SLAS,
  GVTL,
  PPEQ,
  PMUN,
  PSPA,
  TD_LSFT_CAPS,
  TD_RSFT_CAPS,
  LEFT_BRACKETS,
  RIGHT_BRACKETS,
  TD_PGDN_PGUP,
  TD_NEXT_PREV
};

void dance_LEFT_BRACKETS_finished(qk_tap_dance_state_t *state, void *user_data) {
  switch(state->count){
    case 1: {  // Open parenthesis on single tap
      register_code16(KC_LPRN);
      break;
    }
    case 2: { // Open square bracket on second tap
      register_code16(KC_LBRC);
      break;
    }
    case 3: { // Open curly brace on third tap
      register_code16(KC_LCBR);
      break;
    }
    case 4: { // Open angle bracket on fourth tap
      register_code16(KC_LABK);
      break;
    }
    default: {
      break;
    }
  }
}
void dance_LEFT_BRACKETS_reset(qk_tap_dance_state_t *state, void *user_data) {
  switch(state->count){
    case 1: {  // Open parenthesis on single tap
      unregister_code16(KC_LPRN);
      break;
    }
    case 2: { // Open square bracket on second tap
      unregister_code16(KC_LBRC);
      break;
    }
    case 3: { // Open curly brace on third tap
      unregister_code16(KC_LCBR);
      break;
    }
    case 4: { // Open angle bracket on fourth tap
      unregister_code16(KC_LABK);
      break;
    }
    default: {
      break;
    }
  }
}


void dance_RIGHT_BRACKETS_finished(qk_tap_dance_state_t *state, void *user_data) {
  switch(state->count){
    case 1: {  // Close parenthesis on single tap
      register_code16(KC_RPRN);
      break;
    }
    case 2: { // Close square bracket on second tap
      register_code16(KC_RBRC);
      break;
    }
    case 3: { // Close curly brace on third tap
      register_code16(KC_RCBR);
      break;
    }
    case 4: { // Close angle bracket on fourth tap
      register_code16(KC_RABK);
      break;
    }
    default: {
      break;
    }
  }
}

void dance_RIGHT_BRACKETS_reset(qk_tap_dance_state_t *state, void *user_data) {
  switch(state->count){
    case 1: {  // Close parenthesis on single tap
      unregister_code16(KC_RPRN);
      break;
    }
    case 2: { // Close square bracket on second tap
      unregister_code16(KC_RBRC);
      break;
    }
    case 3: { // Close curly brace on third tap
      unregister_code16(KC_RCBR);
      break;
    }
    case 4: { // Close angle bracket on fourth tap
      unregister_code16(KC_RABK);
      break;
    }
    default: {
      break;
    }
  }
}

qk_tap_dance_action_t tap_dance_actions[] = {
//  1-tap => ( / 2-tap  => [ / 3-tap  => { / 4-tap  => <
[LEFT_BRACKETS]  = ACTION_TAP_DANCE_FN_ADVANCED(NULL, dance_LEFT_BRACKETS_finished, dance_LEFT_BRACKETS_reset),
//  1-tap => ) / 2-tap  => ] / 3-tap  => } 4-tap  => >
[RIGHT_BRACKETS]  = ACTION_TAP_DANCE_FN_ADVANCED(NULL, dance_RIGHT_BRACKETS_finished, dance_RIGHT_BRACKETS_reset),
// 1-tap held => shift, 2-tap => caps lock
[TD_LSFT_CAPS] = ACTION_TAP_DANCE_DOUBLE(KC_LSFT, KC_CAPS),
// 1-tap held => shift, 2-tap => caps lock
[TD_RSFT_CAPS] = ACTION_TAP_DANCE_DOUBLE(KC_RSFT, KC_CAPS),
// 1-tap  => Page down, 2-tap  => Page up
[TD_PGDN_PGUP] = ACTION_TAP_DANCE_DOUBLE(KC_PGDN, KC_PGUP),
// 1-tap  => Next Track, 2-tap  => Previous Track
[TD_NEXT_PREV] = ACTION_TAP_DANCE_DOUBLE(KC_MNXT, KC_MPRV),

// Symbol doubles
[LBCB] = ACTION_TAP_DANCE_DOUBLE(KC_LBRC, KC_LCBR),  // Left bracket on a single-tap, left brace on a double-tap
[RBCB] = ACTION_TAP_DANCE_DOUBLE(KC_RBRC, KC_RCBR),  // Right bracket on a single-tap, right brace on a double-tap
[LPAB] = ACTION_TAP_DANCE_DOUBLE(KC_LPRN, KC_LABK),  // Right Parenthesis on a single-tap, right angle bracket on a double-tap
[RPAB] = ACTION_TAP_DANCE_DOUBLE(KC_RPRN, KC_RABK),  // Right Parenthesis on a single-tap, right angle bracket on a double-tap
[EQPL] = ACTION_TAP_DANCE_DOUBLE(KC_EQL, KC_PLUS),   // Plus sign on a single-tap, equal sign on a double-tap
[PLEQ] = ACTION_TAP_DANCE_DOUBLE(KC_PLUS, KC_EQL),   // Equal sign on a single-tap, plus sign on a double-tap
[MNUN] = ACTION_TAP_DANCE_DOUBLE(KC_MINS, KC_UNDS),  // Minus sign on a single-tap, underscore on a double-tap
[SLAS] = ACTION_TAP_DANCE_DOUBLE(KC_SLSH, KC_ASTR),  // Slash in a single-tap, asterisk in a double-tap
[GVTL] = ACTION_TAP_DANCE_DOUBLE(KC_GRV, KC_TILD),   // Grave on a single-tap, tilde on a double-tap
[PPEQ] = ACTION_TAP_DANCE_DOUBLE(KC_PPLS, KC_EQL),   // Numpad plus sign on a single-tap, equal sign on a double-tap
[PMUN] = ACTION_TAP_DANCE_DOUBLE(KC_PMNS, KC_UNDS),  // Numpad minus sign on a single-tap, underscore on a double-tap
[PSPA] = ACTION_TAP_DANCE_DOUBLE(KC_PSLS, KC_PAST)   // Numpad slash on a single-tap, numpad asterisk on a double-tap
};

// Aliases for longer keycodes ********************************************************************************************************************************************
#define NKROTG  MAGIC_TOGGLE_NKRO

// Tap Dances
#define TD_LBRK   TD(LEFT_BRACKETS)
#define TD_RBRK   TD(RIGHT_BRACKETS)
#define TD_LSHCAP TD(TD_LSFT_CAPS)
#define TD_RSHCAP TD(TD_RSFT_CAPS)
#define TD_PAGE   TD(TD_PGDN_PGUP)
#define TD_NXPR   TD(TD_NEXT_PREV)
#define TD_LBCB   TD(LBCB)
#define TD_RBCB   TD(RBCB)
#define TD_LPAB   TD(LPAB)
#define TD_RPAB   TD(RPAB)
#define TD_EQPL   TD(EQPL)
#define TD_PLEQ   TD(PLEQ)
#define TD_MNUN   TD(MNUN)
#define TD_SLAS   TD(SLAS)
#define TD_GVTL   TD(GVTL)
#define TD_PPEQ   TD(PPEQ)
#define TD_PMUN   TD(PMUN)
#define TD_PSPA   TD(PSPA)

// Layers
#define TO_BASE   TO(_BASE)
#define TG_MAC    TG(_MACOS)
#define TG_ADV    TG(_ADVANCED)
#define TG_GAME   TG(_GAME)
#define OSL_ANT   OSL(_ADJUST)
#define TG_NUM    TG(_NUMPAD)

// Mixed key / Layers
#define LT_SPCFN  LT(_FUNCTION, KC_SPC)
#define LT_BSPCFN LT(_FUNCTION, KC_BSPC)
#define LT_ENTNS  LT(_NUMBERS, KC_ENT)
#define LT_DELNS  LT(_NUMBERS2, KC_DEL)
// ************************************************************************************************************************************************************************



const uint16_t PROGMEM keymaps[][MATRIX_ROWS][MATRIX_COLS] = {
/**************************************************************************************************************************************************************************
Layer 0: Base
Base Layer for all others, basic QWERTY input with limited layer hopping ability.
***************************************************************************************************************************************************************************

,--------------------------------------------------------------.                                     ,--------------------------------------------------------------.
| CAPS | BASE | MAC  | ADV  |      |      |      |      | GAME |                                     |      |      |      |      |      |      |      |TG_NUM|OSLANT|
`--------------------------------------------------------------'                                     `--------------------------------------------------------------'
,------------------------------------------------------.                                                     ,------------------------------------------------------.
|    =    |    1   |    2   |    3   |    4   |    5   |                                                     |    6   |    7   |    8   |    9   |    0   |    -    |
|---------+--------+--------+--------+--------+--------|                                                     |--------+--------+--------+--------+--------+---------|
|   Tab   |    Q   |    W   |    E   |    R   |    T   |                                                     |    Y   |    U   |    I   |    O   |    P   |    \    |
|---------+--------+--------+--------+--------+--------|                                                     |--------+--------+--------+--------+--------+---------|
|   ESC   |    A   |    S   |    D   |    F   |    G   |                                                     |    H   |    J   |    K   |    L   |    ;   |    '    |
|---------+--------+--------+--------+--------+--------|                                                     |--------+--------+--------+--------+--------+---------|
|Shft/CAPS|    Z   |    X   |    C   |    V   |    B   |                                                     |    N   |    M   |    ,   |    .   |    /   |Shft/CAPS|
`---------+--------+--------+--------+--------+--------'                                                     `--------+--------+--------+--------+--------+---------'
          |    `   |XXXXXXXX|    [   |    ]   |                                                                       |  Left  |  Down  |   Up   |  Right |
          `-----------------------------------'                                                                       `-----------------------------------'
	                                                   ,-----------------.                 ,-----------------.
	                                                   |  LCtrl |  LAlt  |                 |  RAlt  |  RCtrl |
	                                          ,--------+--------+--------|                 |--------+--------+--------.
	                                          |  Space |  Enter |   GUI  |                 |  PAGE  | Delete |  Bspc  |
	                                          |        |        |--------|                 |--------|        |        |
	                                          |        |        | BspcDel|                 |  Enter |        |        |
	                                          `--------------------------'                 `--------------------------'
*/
[_BASE] = LAYOUT_pretty(
  KC_CAPS,   TO_BASE,  TG_MAC,  TG_ADV, _______, _______, _______, _______, TG_GAME, _______, _______, _______, _______, _______, _______, _______, TG_NUM,  OSL_ANT,
  KC_EQL,    KC_1,    KC_2,    KC_3,    KC_4,    KC_5,                                                          KC_6,    KC_7,    KC_8,    KC_9,    KC_0,    KC_MINS,
  KC_TAB,    KC_Q,    KC_W,    KC_E,    KC_R,    KC_T,                                                          KC_Y,    KC_U,    KC_I,    KC_O,    KC_P,    KC_BSLS,
  KC_ESC,    KC_A,    KC_S,    KC_D,    KC_F,    KC_G,                                                          KC_H,    KC_J,    KC_K,    KC_L,    KC_SCLN, KC_QUOT,
  TD_LSHCAP, KC_Z,    KC_X,    KC_C,    KC_V,    KC_B,                                                          KC_N,    KC_M,    KC_COMM, KC_DOT,  KC_SLSH, TD_RSHCAP,
             KC_GRV,  XXXXXXX, KC_LBRC, KC_RBRC,                                                                         KC_LEFT, KC_DOWN, KC_UP,   KC_RGHT,
                                                          KC_LCTL,  KC_RALT,              KC_RGUI, KC_RCTL,
                                                                    KC_LGUI,              TD_PAGE,
                                                    KC_SPC, KC_ENT, CU_BKDL,              KC_ENT,  KC_DEL, KC_BSPC
),


/**************************************************************************************************************************************************************************
Layer 1: MacOS
Changed Thumb clusters to be MacOS oriented.
***************************************************************************************************************************************************************************

,--------------------------------------------------------------.                                     ,--------------------------------------------------------------.
|      |      |      |      |      |      |      |      |      |                                     |      |      |      |      |      |      |      |      |      |
`--------------------------------------------------------------'                                     `--------------------------------------------------------------'
,------------------------------------------------------.                                                     ,------------------------------------------------------.
|         |        |        |        |        |        |                                                     |        |        |        |        |        |         |
|---------+--------+--------+--------+--------+--------|                                                     |--------+--------+--------+--------+--------+---------|
|         |        |        |        |        |        |                                                     |        |        |        |        |        |         |
|---------+--------+--------+--------+--------+--------|                                                     |--------+--------+--------+--------+--------+---------|
|         |        |        |        |        |        |                                                     |        |        |        |        |        |         |
|---------+--------+--------+--------+--------+--------|                                                     |--------+--------+--------+--------+--------+---------|
|         |        |        |        |        |        |                                                     |        |        |        |        |        |         |
`---------+--------+--------+--------+--------+--------'                                                     `--------+--------+--------+--------+--------+---------'
          |        |        |        |        |                                                                       |        |        |        |        |
          `-----------------------------------'                                                                       `-----------------------------------'
	                                                   ,-----------------.                 ,-----------------.
	                                                   | ⌘(GUI) |        |                 | ⌘(GUI) |  Ctrl  |
	                                          ,--------+--------+--------|                 |--------+--------+--------.
	                                          |        |        |  Ctrl  |                 |        |        |        |
	                                          |        |        |--------|                 |--------|        |        |
	                                          |        |        |        |                 |        |        |        |
	                                          `--------------------------'                 `--------------------------'
*/
[_MACOS] = LAYOUT_pretty(
  _______, _______, _______, _______, _______, _______, _______, _______, _______, _______, _______, _______, _______, _______, _______, _______, _______, _______,
  _______, _______, _______, _______, _______, _______,                                                       _______, _______, _______, _______, _______, _______,
  _______, _______, _______, _______, _______, _______,                                                       _______, _______, _______, _______, _______, _______,
  _______, _______, _______, _______, _______, _______,                                                       _______, _______, _______, _______, _______, _______,
  _______, _______, _______, _______, _______, _______,                                                       _______, _______, _______, _______, _______, _______,
           _______, _______, _______, _______,                                                                         _______, _______, _______, _______,
                                                        KC_LGUI,  _______,                  KC_RCTL, KC_RGUI,
                                                                  KC_LCTL,                  _______,
                                               _______, _______,  _______,                  _______, _______, _______
),


/**************************************************************************************************************************************************************************
Layer 2: Advanced
Advanced usage of certain keys.
***************************************************************************************************************************************************************************
,--------------------------------------------------------------.                                     ,--------------------------------------------------------------.
|      |      |      |      |      |      |      |      |      |                                     |      |      |      |      |      |      |      |      |      |
`--------------------------------------------------------------'                                     `--------------------------------------------------------------'
,------------------------------------------------------.                                                     ,------------------------------------------------------.
|         |        |        |        |        |        |                                                     |        |        |        |        |        |         |
|---------+--------+--------+--------+--------+--------|                                                     |--------+--------+--------+--------+--------+---------|
|         |        |        |        |        |        |                                                     |        |        |        |        |        |         |
|---------+--------+--------+--------+--------+--------|                                                     |--------+--------+--------+--------+--------+---------|
|         |        |        |        |        |        |                                                     |        |        |        |        |        |         |
|---------+--------+--------+--------+--------+--------|                                                     |--------+--------+--------+--------+--------+---------|
|         |        |        |        |        |        |                                                     |        |        |        |        |        |         |
`---------+--------+--------+--------+--------+--------'                                                     `--------+--------+--------+--------+--------+---------'
          |        |        | TD_LBRK| TD_RBRK|                                                                       |        |        |        |        |
          `-----------------------------------'                                                                       `-----------------------------------'
	                                                   ,-----------------.                 ,-----------------.
	                                                   |        |        |                 |        |        |
	                                          ,--------+--------+--------|                 |--------+--------+--------.
	                                          |  Space |  Enter |        |                 |        | Delete |  Bspc  |
	                                          |    /   |    /   |--------|                 |--------|    /   |    /   |
	                                          |   Fn   | Number |        |                 |        | Number2|   Fn2  |
	                                          `--------------------------'                 `--------------------------'
*/
[_ADVANCED] = LAYOUT_pretty(
  _______, _______, _______, _______, _______, _______, _______, _______, _______, _______, _______, _______, _______, _______, _______, _______, _______, _______,
  _______, _______, _______, _______, _______, _______,                                                       _______, _______, _______, _______, _______, _______,
  _______, _______, _______, _______, _______, _______,                                                       _______, _______, _______, _______, _______, _______,
  _______, _______, _______, _______, _______, _______,                                                       _______, _______, _______, _______, _______, _______,
  _______, _______, _______, _______, _______, _______,                                                       _______, _______, _______, _______, _______, _______,
           _______, _______, TD_LBRK, TD_RBRK,                                                                         _______, _______, _______, _______,
                                                        _______,  _______,                  _______, _______,
                                                                  _______,                  _______,
                                              LT_SPCFN, LT_ENTNS, _______,                  _______, LT_DELNS, LT_BSPCFN
),


/**************************************************************************************************************************************************************************
Layer 3: Functional
Access to F keys and other functional buttons
***************************************************************************************************************************************************************************
,--------------------------------------------------------------.                                     ,--------------------------------------------------------------.
|      |      |      |      |      |      |      |      |      |                                     |      |      |      |      |      |      |      |      |      |
`--------------------------------------------------------------'                                     `--------------------------------------------------------------'
,------------------------------------------------------.                                                     ,------------------------------------------------------.
|   F12   |   F1   |   F2   |   F3   |   F4   |   F5   |                                                     |   F6   |   F7   |   F8   |   F9   |   F10  |   F11   |
|---------+--------+--------+--------+--------+--------|                                                     |--------+--------+--------+--------+--------+---------|
|Mouse Ac0|        |        |Mouse U |        |        |                                                     |        |        |        |        |        |         |
|---------+--------+--------+--------+--------+--------|                                                     |--------+--------+--------+--------+--------+---------|
|Mouse Ac1|        |Mouse L |Mouse D |Mouse R |        |                                                     |        |        |        |        |        |         |
|---------+--------+--------+--------+--------+--------|                                                     |--------+--------+--------+--------+--------+---------|
|Mouse Ac2|        |        |        |        |        |                                                     |        |  Mute  |  Prev  |  Next  |        |         |
`---------+--------+--------+--------+--------+--------'                                                     `--------+--------+--------+--------+--------+---------'
          |        |        |        |        |                                                                       |TD_NXPR | Vol -  |  Vol + |  Play  |
          `-----------------------------------'                                                                       `-----------------------------------'
	                                                   ,-----------------.                 ,-----------------.
	                                                   |Mouse B1|Mouse B2|                 |        |        |
	                                          ,--------+--------+--------|                 |--------+--------+--------.
	                                          |        |        |Mouse B3|                 |        |        |        |
	                                          |        |        |--------|                 |--------|        |        |
	                                          |        |        |        |                 |        |        |        |
	                                          `--------------------------'                 `--------------------------'
*/
[_FUNCTION] = LAYOUT_pretty(
  _______, _______, _______, _______, _______, _______, _______, _______, _______, _______, _______, _______, _______, _______, _______, _______, _______, _______,
  KC_F12,  KC_F1,   KC_F2,   KC_F3,   KC_F4,   KC_F5,                                                         KC_F6,   KC_F7,   KC_F8,   KC_F9,   KC_F10,  KC_F11,
  KC_ACL0, _______, _______, KC_MS_U, _______, _______,                                                       _______, _______, _______, _______, _______, _______,
  KC_ACL0, _______, KC_MS_L, KC_MS_D, KC_MS_R, _______,                                                       _______, _______, _______, _______, _______, _______,
  KC_ACL0, _______, _______, _______, _______, _______,                                                       _______, KC_MUTE, KC_MPRV, KC_MNXT, _______, _______,
           _______, _______, _______, _______,                                                                         TD_NXPR, KC_VOLD, KC_VOLU, KC_MPLY,
                                                        KC_BTN1, KC_BTN2,                   _______, _______,
                                                                 KC_BTN3,                   _______,
                                              _______,  _______, _______,                   _______, _______, _______
),


/**************************************************************************************************************************************************************************
Layer 4,5: Numbers
Quick access to numbers and symbols. Two symbols in same key are tap dance.
***************************************************************************************************************************************************************************
,--------------------------------------------------------------.                                     ,--------------------------------------------------------------.
|      |      |      |      |      |      |      |      |      |                                     |      |      |      |      |      |      |      |      |      |
`--------------------------------------------------------------'                                     `--------------------------------------------------------------'
,------------------------------------------------------.                                                     ,------------------------------------------------------.
|   F12   |   F1   |   F2   |   F3   |   F4   |   F5   |                                                     |   F6   |   F7   |   F8   |   F9   |   F10  |   F11   |
|---------+--------+--------+--------+--------+--------|                                                     |--------+--------+--------+--------+--------+---------|
|         |    6   |    7   |    8   |    9   |    0   |                                                     |   ^    |    &   |    *   |    (   |    )   |         |
|---------+--------+--------+--------+--------+--------|                                                     |--------+--------+--------+--------+--------+---------|
|         |    1   |    2   |    3   |    4   |    5   |                                                     |   !    |    @   |    #   |    $   |    %   |         |
|---------+--------+--------+--------+--------+--------|                                                     |--------+--------+--------+--------+--------+---------|
|         |   ` ~  |    .   |   / *  |   - _  |   + =  |                                                     |   ` ~  |        |        |        |        |         |
`---------+--------+--------+--------+--------+--------'                                                     `--------+--------+--------+--------+--------+---------'
          |  (  <  |  )  >  |  [  {  |  ]  }  |                                                                       |        |        |        |        |
          `-----------------------------------'                                                                       `-----------------------------------'
	                                                   ,-----------------.                 ,-----------------.
	                                                   |        |        |                 |        |        |
	                                          ,--------+--------+--------|                 |--------+--------+--------.
	                                          |        |        |        |                 |        |        |        |
	                                          |        |        |--------|                 |--------|        |        |
	                                          |        |        |        |                 |        |        |        |
	                                          `--------------------------'                 `--------------------------'
*/
[_NUMBERS] = LAYOUT_pretty(
  _______, _______, _______, _______, _______, _______, _______, _______, _______, _______, _______, _______, _______, _______, _______, _______, _______, _______,
  KC_F12,  KC_F1,   KC_F2,   KC_F3,   KC_F4,   KC_F5,                                                         KC_F6,   KC_F7,   KC_F8,   KC_F9,   KC_F10,  KC_F11,
  _______, KC_6,    KC_7,    KC_8,    KC_9,    KC_0,                                                          KC_CIRC, KC_AMPR, KC_ASTR, KC_LPRN, KC_RPRN, _______,
  _______, KC_1,    KC_2,    KC_3,    KC_4,    KC_5,                                                          KC_EXLM, KC_AT,   KC_HASH, KC_DLR,  KC_PERC, _______,
  _______, _______, KC_DOT,  TD_SLAS, TD_MNUN, TD_PLEQ,                                                       TD_GVTL, _______, _______, _______, _______, _______,
           TD_LPAB, TD_RPAB, TD_LBCB, TD_RBCB,                                                                         _______, _______, _______, _______,
                                                        _______, _______,                   _______, _______,
                                                                 _______,                   _______,
                                               _______, _______, _______,                   _______, _______, _______
),
[_NUMBERS2] = LAYOUT_pretty(
  _______, _______, _______, _______, _______, _______, _______, _______, _______, _______, _______, _______, _______, _______, _______, _______, _______, _______,
  KC_F12,  KC_F1,   KC_F2,   KC_F3,   KC_F4,   KC_F5,                                                         KC_F6,   KC_F7,   KC_F8,   KC_F9,   KC_F10,  KC_F11,
  _______, KC_6,    KC_7,    KC_8,    KC_9,    KC_0,                                                          KC_CIRC, KC_AMPR, KC_ASTR, KC_LPRN, KC_RPRN, _______,
  _______, KC_1,    KC_2,    KC_3,    KC_4,    KC_5,                                                          KC_EXLM, KC_AT,   KC_HASH, KC_DLR,  KC_PERC, _______,
  _______, _______, KC_DOT,  TD_SLAS, TD_MNUN, TD_PLEQ,                                                       TD_GVTL, TD_LBCB, TD_RBCB, _______, _______, _______,
           TD_LPAB, TD_RPAB, TD_LBCB, TD_RBCB,                                                                         _______, _______, _______, _______,
                                                        _______, _______,                   _______, _______,
                                                                 _______,                   _______,
                                               _______, _______, _______,                   _______, _______, _______
),


/**************************************************************************************************************************************************************************
Layer 6: Numpad
Number
***************************************************************************************************************************************************************************
,--------------------------------------------------------------.                                     ,--------------------------------------------------------------.
|      |      |      |      |      |      |      |      |      |                                     |      |      |      |      |      |      |      |      |      |
`--------------------------------------------------------------'                                     `--------------------------------------------------------------'
,------------------------------------------------------.                                                     ,------------------------------------------------------.
|         | NumLock|        |        |        |        |                                                     |   Tab  | NumLock|  KP /  |  KP *  |  KP -  |         |
|---------+--------+--------+--------+--------+--------|                                                     |--------+--------+--------+--------+--------+---------|
|         |  KP 6  |  KP 7  |  KP 8  |  KP 9  |  KP 0  |                                                     |        |  KP 7  |  KP 8  |  KP 9  |  KP +  |         |
|---------+--------+--------+--------+--------+--------|                                                     |--------+--------+--------+--------+--------+---------|
|         |  KP 1  |  KP 2  |  KP 3  |  KP 4  |  KP 5  |                                                     |        |  KP 4  |  KP 5  |  KP 6  |   =    |         |
|---------+--------+--------+--------+--------+--------|                                                     |--------+--------+--------+--------+--------+---------|
|         |        |  KP .  | KP/KP* |  KP- _ |  KP+ = |                                                     |        |  KP 1  |  KP 2  |  KP 3  | KP Ent |         |
`---------+--------+--------+--------+--------+--------'                                                     `--------+--------+--------+--------+--------+---------'
          |    (   |    )   |   [ {  |   ] }  |                                                                       |        |  KP 0  |  KP .  | KP Ent |
          `-----------------------------------'                                                                       `-----------------------------------'
	                                                   ,-----------------.                 ,-----------------.
	                                                   |        |        |                 |        |        |
	                                          ,--------+--------+--------|                 |--------+--------+--------.
	                                          |        |        |        |                 |        |        |        |
	                                          |        |        |--------|                 |--------|        |        |
	                                          |        |        |        |                 |        |        |        |
	                                          `--------------------------'                 `--------------------------'
*/
[_NUMPAD] = LAYOUT_pretty(
  _______, _______, _______, _______, _______, _______, _______, _______, _______, _______, _______, _______, _______, _______, _______, _______, _______, _______,
  _______, KC_NLCK, _______, _______, _______, _______,                                                       KC_TAB,  KC_NLCK, KC_PSLS, KC_PAST, KC_PMNS, _______,
  _______, KC_P6,   KC_P7,   KC_P8,   KC_P9,   KC_P0,                                                         _______, KC_P7,   KC_P8,   KC_P9,   KC_PPLS, _______,
  _______, KC_P1,   KC_P2,   KC_P3,   KC_P4,   KC_P5,                                                         _______, KC_P4,   KC_P5,   KC_P6,   KC_EQL,  _______,
  _______, _______, KC_PDOT, TD_PSPA, TD_MNUN, TD_PPEQ,                                                       _______, KC_P1,   KC_P2,   KC_P3,   KC_PENT, _______,
           KC_LPRN, KC_RPRN, TD_LBCB, TD_RBCB,                                                                         _______, KC_P0,   KC_PDOT, KC_PENT,
                                                        _______, _______,                   _______, _______,
                                                                 _______,                   _______,
                                               _______, _______, _______,                   _______, _______, _______
),



/**************************************************************************************************************************************************************************
Layer 7: Game
Gaming layer shifts WASD over and changes thumb clusters for games.
***************************************************************************************************************************************************************************
,------------------------------------------------------.                                                     ,------------------------------------------------------.
|         |        |        |        |        |        |                                                     |        |        |        |        |        |         |
|---------+--------+--------+--------+--------+--------|                                                     |--------+--------+--------+--------+--------+---------|
|   Tab   |    T   |    Q   |    W   |    E   |    R   |                                                     |        |        |        |        |        |         |
|---------+--------+--------+--------+--------+--------|                                                     |--------+--------+--------+--------+--------+---------|
|   ESC   |    G   |    A   |    S   |    D   |    F   |                                                     |        |        |        |        |        |         |
|---------+--------+--------+--------+--------+--------|                                                     |--------+--------+--------+--------+--------+---------|
|  Shft   |    B   |    Z   |    X   |    C   |    V   |                                                     |        |        |        |        |        |         |
`---------+--------+--------+--------+--------+--------'                                                     `--------+--------+--------+--------+--------+---------'
          |    `   |        |        |        |                                                                       |        |        |        |        |
          `-----------------------------------'                                                                       `-----------------------------------'
	                                                   ,-----------------.                 ,-----------------.
	                                                   |   Shft |  Ctrl  |                 |        |        |
	                                          ,--------+--------+--------|                 |--------+--------+--------.
	                                          |  Space |  Enter |   Tab  |                 |        |        |        |
	                                          |        |        |--------|                 |--------|        |        |
	                                          |        |        |   Alt  |                 |        |        |        |
	                                          `--------------------------'                 `--------------------------'
*/
[_GAME] = LAYOUT_pretty(
  _______, _______, _______, _______, _______, _______, _______, _______, _______, _______, _______, _______, _______, _______, _______, _______, _______, _______,
  _______, _______, _______, _______, _______, _______,                                                       _______, _______, _______, _______, _______, _______,
  KC_TAB,  KC_T,    KC_Q,    KC_W,    KC_E,    KC_R,                                                          _______, _______, _______, _______, _______, _______,
  KC_ESC,  KC_G,    KC_A,    KC_S,    KC_D,    KC_F,                                                          _______, _______, _______, _______, _______, _______,
  KC_LSFT, KC_B,    KC_Z,    KC_X,    KC_C,    KC_V,                                                          _______, _______, _______, _______, _______, _______,
           _______, _______, _______, _______,                                                                         _______, _______, _______, _______,
                                                        KC_LSFT, KC_LCTL,                   _______, _______,
                                                                 KC_TAB,                    _______,
                                               KC_SPC,  KC_ENT,  KC_LALT,                   _______, _______, _______
),


/**************************************************************************************************************************************************************************
Layer 8,9: Adjust
Utility layer for keyboard, press same OSL key to exit if accessed via OSL.
***************************************************************************************************************************************************************************
,--------------------------------------------------------------.                                     ,--------------------------------------------------------------.
|      |      |      |      |      |      |      |      |      |                                     |      |      |      |      |      |      |      |      | EXIT |
`--------------------------------------------------------------'                                     `--------------------------------------------------------------'
,------------------------------------------------------.                                                     ,------------------------------------------------------.
| TO BASE | TG MAC | TG ADV |        |        | TG GAME|                                                     |  MOCK  |        |        |        |        |  RESET  |
|---------+--------+--------+--------+--------+--------|                                                     |--------+--------+--------+--------+--------+---------|
|         |        |        |        |        |        |                                                     |        |        |        |        |        |         |
|---------+--------+--------+--------+--------+--------|                                                     |--------+--------+--------+--------+--------+---------|
|         |        |        |        |        |        |                                                     |        |        |        |        |        |         |
|---------+--------+--------+--------+--------+--------|                                                     |--------+--------+--------+--------+--------+---------|
|         |        |        |        |        |        |                                                     |        |        |        |        |        |NKRO TOGL|
`---------+--------+--------+--------+--------+--------'                                                     `--------+--------+--------+--------+--------+---------'
          |        |        |        |        |                                                                       |        |        |        |        |
          `-----------------------------------'                                                                       `-----------------------------------'
	                                                   ,-----------------.                 ,-----------------.
	                                                   |        |        |                 |        |        |
	                                          ,--------+--------+--------|                 |--------+--------+--------.
	                                          |        |        |        |                 |        |        |        |
	                                          |        |        |--------|                 |--------|        |        |
	                                          |        |        |        |                 |        |        |        |
	                                          `--------------------------'                 `--------------------------'
*/
[_ADJUST] = LAYOUT_pretty(
  _______, _______, _______, _______, _______, _______, _______, _______, _______, _______, _______, _______, _______, _______, _______, _______, _______, XXXXXXX,
  TO_BASE, TG_MAC,  TG_ADV,  _______, _______, TG_GAME,                                                       CU_MOCK, _______, _______, _______, _______, RESET,
  _______, _______, _______, _______, _______, _______,                                                       _______, _______, _______, _______, _______, _______,
  _______, _______, _______, _______, _______, _______,                                                       _______, _______, _______, _______, _______, _______,
  _______, _______, _______, _______, _______, _______,                                                       _______, _______, _______, _______, _______, NKROTG,
           _______, _______, _______, _______,                                                                         _______, _______, _______, _______,
                                                        _______, _______,                   _______, _______,
                                                                 _______,                   _______,
                                              _______,  _______, _______,                   _______, _______, _______
),
[_ADJUST2] = LAYOUT_pretty(
  _______, _______, _______, _______, _______, _______, _______, _______, _______, _______, _______, _______, _______, _______, _______, _______, _______, XXXXXXX,
  TO_BASE, TG_MAC,  TG_ADV,  _______, _______, TG_GAME,                                                       CU_MOCK, _______, _______, _______, _______, RESET,
  _______, _______, _______, _______, _______, _______,                                                       _______, _______, _______, _______, _______, _______,
  _______, _______, _______, _______, _______, _______,                                                       _______, _______, _______, _______, _______, _______,
  _______, _______, _______, _______, _______, _______,                                                       _______, _______, _______, _______, _______, NKROTG,
           _______, _______, _______, _______,                                                                         _______, _______, _______, _______,
                                                        _______, _______,                   _______, _______,
                                                                 _______,                   _______,
                                              _______,  _______, _______,                   _______, _______, _______
),





// /**************************************************************************************************************************************************************************
// Layer X: TEMPLATE
// TEMPLATE DESCRIPTION
// ***************************************************************************************************************************************************************************
// ,--------------------------------------------------------------.                                     ,--------------------------------------------------------------.
// |      |      |      |      |      |      |      |      |      |                                     |      |      |      |      |      |      |      |      |      |
// `--------------------------------------------------------------'                                     `--------------------------------------------------------------'
// ,------------------------------------------------------.                                                     ,------------------------------------------------------.
// |         |        |        |        |        |        |                                                     |        |        |        |        |        |         |
// |---------+--------+--------+--------+--------+--------|                                                     |--------+--------+--------+--------+--------+---------|
// |         |        |        |        |        |        |                                                     |        |        |        |        |        |         |
// |---------+--------+--------+--------+--------+--------|                                                     |--------+--------+--------+--------+--------+---------|
// |         |        |        |        |        |        |                                                     |        |        |        |        |        |         |
// |---------+--------+--------+--------+--------+--------|                                                     |--------+--------+--------+--------+--------+---------|
// |         |        |        |        |        |        |                                                     |        |        |        |        |        |         |
// `---------+--------+--------+--------+--------+--------'                                                     `--------+--------+--------+--------+--------+---------'
//           |        |        |        |        |                                                                       |        |        |        |        |
//           `-----------------------------------'                                                                       `-----------------------------------'
// 	                                                   ,-----------------.                 ,-----------------.
// 	                                                   |        |        |                 |        |        |
// 	                                          ,--------+--------+--------|                 |--------+--------+--------.
// 	                                          |        |        |        |                 |        |        |        |
// 	                                          |        |        |--------|                 |--------|        |        |
// 	                                          |        |        |        |                 |        |        |        |
// 	                                          `--------------------------'                 `--------------------------'
// */
// [_TEMPLATE] = LAYOUT_pretty(
//   _______, _______, _______, _______, _______, _______, _______, _______, _______, _______, _______, _______, _______, _______, _______, _______, _______, _______,
//   _______, _______, _______, _______, _______, _______,                                                       _______, _______, _______, _______, _______, _______,
//   _______, _______, _______, _______, _______, _______,                                                       _______, _______, _______, _______, _______, _______,
//   _______, _______, _______, _______, _______, _______,                                                       _______, _______, _______, _______, _______, _______,
//   _______, _______, _______, _______, _______, _______,                                                       _______, _______, _______, _______, _______, _______,
//            _______, _______, _______, _______,                                                                         _______, _______, _______, _______,
//                                                         _______, _______,                   _______, _______,
//                                                                  _______,                   _______,
//                                               _______,  _______, _______,                   _______, _______, _______
// ),
};

void process_mock_mode(uint16_t keycode, bool key_pressed) {
  if (key_pressed) {  // Key pressed
    if (mock_mode_shift_enable) {
      tap_code16(S(keycode));
    } else {
      tap_code16(keycode);
    }
    mock_mode_shift_enable^=true;
  }
}

void enable_led(uint8_t led_num, bool enable) {
  if(enable){
    PORTF &= ~(1<<led_num);
  } else {
    PORTF |=  (1<<led_num);
  }
}

void handle_layer_leds(uint32_t state) {
  // Default Disabled
  enable_led(RED_LED, false);
  enable_led(ORANGE_LED, false);
  enable_led(GREEN_LED, false);
  enable_led(BLUE_LED, false);

  if(state & (1<<_GAME)){
    enable_led(RED_LED, true);
  }
  if(state & (1<<_ADVANCED)){
    enable_led(ORANGE_LED, true);
  }
  if(state & (1<<_FUNCTION)){
    enable_led(GREEN_LED, true);
  }
  if(state & (1<<_MACOS)){
    enable_led(BLUE_LED, true);
  }
}

uint32_t layer_state_set_user(uint32_t state) {
  handle_layer_leds(state);
  // When _NUMBERS and _NUMBERS2 active, acitvate ANTECHAMBER
  return update_tri_layer_state(state, _NUMBERS, _NUMBERS2, _ADJUST2);
}

bool process_record_user(uint16_t keycode, keyrecord_t *record) {
  switch (keycode) {
    case CU_BKDL: {
      if(!record->event.pressed){
        return false;  // Do nothing on key up
      }

      if( get_mods() & MOD_BIT(KC_LSHIFT)) {
        // Send "Delete" on shift+backspace
        unregister_code(KC_LSHIFT);
        tap_code(KC_DEL);
        register_code(KC_LSHIFT);
      } else {
        // Send backspace
        tap_code(KC_BSPC);
      }
      return false;
    }
    case CU_MOCK: {
      if(!record->event.pressed){
        return false;
      }
      mock_mode_enable ^= true;  // Toggle mock mode.
      // Set first character to capital if just enabled
      mock_mode_shift_enable = mock_mode_enable ? true : false;
      return false;
    }
    case KC_A ... KC_Z: {
      if(mock_mode_enable) {  // Send alternating shifted key
        process_mock_mode(keycode, record->event.pressed);
        return false;
      }
      return true;  // Handle keycode.
    }
    case KC_BSPC: {
      if(mock_mode_enable && record->event.pressed) {  // Send alternating shifted key
        mock_mode_shift_enable^=true;
      }
      return true;  // Handle keycode.
    }
    default: {
      return true;
    }
  }
  return true;
}